## conf/bblayers.conf.sample
```bitbake
# LAYER_CONF_VERSION is increased each time build/conf/bblayers.conf
# changes incompatibly
LCONF_VERSION = "6"

BBPATH = "${TOPDIR}"
BBFILES ?= ""

BBLAYERS ?= " \
  ##COREBASE##/meta \
  ##COREBASE##/meta-yocto \
  ##COREBASE##/meta-dm368ipnc \
  "

#w BBLAYERS ?= " \
#w   ##COREBASE##/meta \
#w   ##COREBASE##/meta-yocto \
#w   ##COREBASE##/meta-openembedded/meta-oe \
#w   ##COREBASE##/meta-dm368ipnc \
#w   "
```

## conf/layer.conf
```bitbake
# We have a conf and classes directory, add to BBPATH
BBPATH .= ":${LAYERDIR}"

# We have a packages|recipes directory, add to BBFILES
BBFILES += "${LAYERDIR}/recipes-*/*/*.bb \
            ${LAYERDIR}/recipes-*/*/*.bbappend"

BBFILE_COLLECTIONS += "meta-dm368ipnc"
BBFILE_PATTERN_meta-dm368ipnc = "^${LAYERDIR}/"
BBFILE_PRIORITY_meta-dm368ipnc = "17"

APPRO_MIRROR ?= "http://www.freescale.com/lgfiles/NMG/MAD/YOCTO/"

MIRRORS += " \
${APPRO_MIRROR}	http://download.ossystems.com.br/bsp/freescale/source/ \n \
"

# Let us add layer-specific bbappends which are only applied when that
# layer is included in our configuration
BBFILES += "${@' '.join('${LAYERDIR}/%s/recipes*/*/*.bbappend' % layer \
               for layer in BBFILE_COLLECTIONS.split())}"
```
